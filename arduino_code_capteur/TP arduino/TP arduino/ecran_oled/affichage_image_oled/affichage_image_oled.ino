/*
  Fichier :       afficherTexteSsd1306.ino
  Description :   Affiche du texte de test, sur un écran OLED i2c de 128x64 pixels,
                  fonctionnant avec un contrôleur SSD1306
  Auteur :        Jérôme TOMSKI (https://passionelectronique.fr/)
  Créé le :       26.07.2021
*/

#include <Adafruit_SSD1306.h>

#define nombreDePixelsEnLargeur 128         // Taille de l'écran OLED, en pixel, au niveau de sa largeur
#define nombreDePixelsEnHauteur 64          // Taille de l'écran OLED, en pixel, au niveau de sa hauteur
#define brocheResetOLED         -1          // Reset de l'OLED partagé avec l'Arduino (d'où la valeur à -1, et non un numéro de pin)
#define adresseI2CecranOLED     0x3C        // Adresse de "mon" écran OLED sur le bus i2c (généralement égal à 0x3C ou 0x3D)

Adafruit_SSD1306 ecranOLED(nombreDePixelsEnLargeur, nombreDePixelsEnHauteur, &Wire, brocheResetOLED);

#define CLKpin 2;
#define DATApin 4;
#define SWITCHpin 5;

//Image a afficher
#define largeurDeLimage           64          // Largeur de l'image à afficher, en pixels
#define hauteurDeLimage           64          // Hauteur de l'image à afficher, en pixels

const unsigned char imageAfficher [] PROGMEM = {
	// 'Smiley-Face-, 64x64px
	0xff, 0xff, 0xff, 0xff, 0xff, 0xff, 0xff, 0xff, 0xff, 0xff, 0xff, 0xff, 0xff, 0xff, 0xff, 0xff, 
	0xff, 0xff, 0xff, 0xff, 0xff, 0xff, 0xff, 0xff, 0xff, 0xff, 0xff, 0xff, 0xff, 0xff, 0xff, 0xff, 
	0xff, 0xff, 0xff, 0xff, 0xff, 0xff, 0xff, 0xff, 0xff, 0xff, 0xff, 0xff, 0xff, 0xff, 0xff, 0xff, 
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	0xff, 0xff, 0xff, 0xff, 0xff, 0xff, 0xff, 0xff, 0xff, 0xff, 0xff, 0xff, 0xff, 0xff, 0xff, 0xff
};

//MENU Display
bool mainMenu = true;
const char* menuItems[] ={"Graphite Sensor","Flex Sensor","Potentiometer"};
const char* potItems[]={"DigiPot 100k settings","R2 value :","BACK"};
const char* flexItems[] = {"Flex sensor reading", "Resistance value:", "Bend angle:", "BACK"};
int selectMenu = 0;



void setup() {

  // Initialisation de l'écran OLED
  if(!ecranOLED.begin(SSD1306_SWITCHCAPVCC, adresseI2CecranOLED))
    while(1);                               // Arrêt du programme (boucle infinie) si échec d'initialisation

    ecranOLED.clearDisplay();                                            // Effaçage de l'intégralité du buffer
    ecranOLED.drawBitmap(
      (ecranOLED.width()  - largeurDeLimage ) / 2,      // Position de l'extrême "gauche" de l'image (pour centrage écran, ici)
      (ecranOLED.height() - hauteurDeLimage) / 2,       // Position de l'extrême "haute" de l'image (pour centrage écran, ici)
      imageAfficher,
      largeurDeLimage,
      hauteurDeLimage,
      WHITE);                                           // "couleur" de l'image
    ecranOLED.display();

  pinMode(CLKpin, INPUT);
  digitalWrite(CLKpin,HIGH);
  pinMode(DATApin,INPUT);
  digitalWrite(DATApin,HIGH);
  pinMode(SWITCHpin, INPUT);
  digitalWrite(SWITCHpin,HIGH);

  // INTERRUPTION FOR THE ROTARY ENCODER
  attachInterrupt(0, updateEncoder, CHANGE);
}

void menuOLED(){

  ecranOLED.clearDiplay();
  for (int i = 0; i < sizeof(menuItems) / sizeof(menuItems[0]); i++) {
    if (i == selectMenu) {
      ecranOLED.setTextColor(SSD1306_BLACK, SSD1306_WHITE); // Highlight selected item
    } else {
      ecranOLED.setTextColor(SSD1306_WHITE);                // Regular color for other items
    }
    ecranOLED.setCursor(0, i * 10);                         // Adjust position for each item
    ecranOLED.print(menuItems[i]);                          // Print each element
  }
  ecranOLED.display();                                      // Display all the elements from the buffer
}

void handleMenuItemSelection(int selectMenu) {
  switch (selectMenu) {       // For each case, if the switch button was pressed, we enter each menu respectively
    case 0:                   // Potentiometer setting using a dedicated function
      displayGraphiteSensor(valuePot);
      break;
    case 1:                   // Flex sensor reading and display using a dedicated function
      displayFlexSensor();
      break;
    case 2:                   // Graphite sensor reading and display using a dedicated function
      displayPotentiometer();
      break;
    default:                  // In case a bug occurs with selectMenu, the code breaks here to avoid extra bugs
      break;
  }
}

void loop() {

}
